//U8G2 version 2.34.22
//ESP32 Dev Module Board version 2.0.0
//-----------------------------------------------------------WiFi,MQTT,OTA-----------------------------------------------------------
#include <PubSubClient.h>
#include <WiFi.h>
#include <ESPmDNS.h>
#include <WiFiUdp.h>
#include <ArduinoOTA.h>
unsigned long previousMillis = 0;
const long interval = 10000;           // interval at which to send mqtt watchdog (milliseconds)

const char* ssid = "Control booth";
const char* password = "MontyLives";
const char* mqtt_server = "192.168.86.102";
#define mqtt_port 1883
#define MQTT_USER ""
#define MQTT_PASSWORD ""
#define MQTT_SERIAL_PUBLISH_CH "/icircuit/ESP32/serialdata/tx"
#define MQTT_SERIAL_RECEIVER_CH "/icircuit/ESP32/serialdata/rx"

//Base notifications
const char* hostName = "Episode 1 Briefcase"; // Set your controller unique name here
const char* quitMessage = "Episode 1 Briefcase quitting...";
const char* onlineMessage = "Episode 1 Briefcase Online";
const char* watchdogMessage = "Episode 1 Briefcase Watchdog";

//mqtt Topics
#define NUM_SUBSCRIPTIONS 2
const char* mainPublishChannel = "/Renegade/Room1/"; //typically /Renegade/Room1/ or /Renegade/Engineering/
const char* dataChannel = "/Renegade/Room1/Briefcase/";
const char* watchdogChannel = "/Renegade/Room1/";
const char* subscribeChannel[NUM_SUBSCRIPTIONS] = {
  "/Renegade/Room1/Briefcase/Control/",
  "/Renegade/Room1/Briefcase/CodeChange/",
  //"myTopic0",
  //"myTopic1",
  //more subscriptions can be added here, separated by commas
};
WiFiClient wifiClient;

PubSubClient client(wifiClient);
//-----------------------------------------------------------Keypad-----------------------------------------------------------
// Use this example with the Adafruit Keypad products.
// You'll need to know the Product ID for your keypad.
// Here's a summary:
//   * PID3844 4x4 Matrix Keypad
//   * PID3845 3x4 Matrix Keypad
//   * PID1824 3x4 Phone-style Matrix Keypad
//   * PID1332 Membrane 1x4 Keypad
//   * PID419  Membrane 3x4 Matrix Keypad

#include "Adafruit_Keypad.h"

// define your specific keypad here via PID
#define KEYPAD_PID3845
// define your pins here
// can ignore ones that don't apply
#define C1    19 //purple
#define C2    33 //blue
#define C3    32 //green
#define R1    23 //orange
#define R2    25 //yellow
#define R3    26 //white
#define R4    27 //red
// leave this import after the above configuration
#include "keypad_config.h"

//initialize an instance of class NewKeypad
Adafruit_Keypad briefcaseKeypad = Adafruit_Keypad( makeKeymap(keys), rowPins, colPins, ROWS, COLS);

//-----------------------------------------------------------Display-----------------------------------------------------------
#include <U8g2lib.h>

#ifdef U8X8_HAVE_HW_SPI
#include <SPI.h>
#endif
#ifdef U8X8_HAVE_HW_I2C
#include <Wire.h>
#endif
// 'pixil-frame-0', 128x64px
const unsigned char ren_logo_pixil_frame_0 [] PROGMEM = {
  0x00, 0x00, 0x00, 0x00, 0x00, 0x00, 0x00, 0x00, 0x00, 0x00, 0x00, 0x00, 0x00, 0x00, 0x00, 0x00,
  0x00, 0x00, 0x00, 0x00, 0x00, 0x00, 0x00, 0x00, 0x00, 0x00, 0x00, 0x00, 0x00, 0x00, 0x00, 0x00,
  0x00, 0x00, 0x00, 0x00, 0x00, 0x00, 0x00, 0x00, 0x00, 0x00, 0x00, 0x00, 0x00, 0x00, 0x00, 0x00,
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  0x00, 0x00, 0x00, 0x00, 0x00, 0x00, 0x00, 0x00, 0x00, 0x00, 0x00, 0x00, 0x00, 0x00, 0x00, 0x00
};
// 'pixil-frame-1', 128x64px
const unsigned char ren_logo_pixil_frame_1 [] PROGMEM = {
  0x00, 0x00, 0x00, 0x00, 0x00, 0x00, 0x00, 0x00, 0x00, 0x00, 0x00, 0x00, 0x00, 0x00, 0x00, 0x00,
  0x00, 0x00, 0x00, 0x00, 0x00, 0x00, 0x00, 0x00, 0x00, 0x00, 0x00, 0x00, 0x00, 0x00, 0x00, 0x00,
  0x00, 0x00, 0x00, 0x00, 0x00, 0x00, 0x00, 0x00, 0x00, 0x00, 0x00, 0x00, 0x00, 0x00, 0x00, 0x00,
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  0x00, 0x00, 0x00, 0x00, 0x00, 0x00, 0x00, 0x00, 0x00, 0x00, 0x00, 0x00, 0x00, 0x00, 0x00, 0x00
};
// 'pixil-frame-2', 128x64px
const unsigned char ren_logo_pixil_frame_2 [] PROGMEM = {
  0x00, 0x00, 0x00, 0x00, 0x00, 0x00, 0x00, 0x00, 0x00, 0x00, 0x00, 0x00, 0x00, 0x00, 0x00, 0x00,
  0x00, 0x00, 0x00, 0x00, 0x00, 0x00, 0x00, 0x00, 0x00, 0x00, 0x00, 0x00, 0x00, 0x00, 0x00, 0x00,
  0x00, 0x00, 0x00, 0x00, 0x00, 0x00, 0x00, 0x00, 0x00, 0x00, 0x00, 0x00, 0x00, 0x00, 0x00, 0x00,
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  0x00, 0x00, 0x00, 0x00, 0x00, 0x00, 0x00, 0x00, 0x00, 0x00, 0x00, 0x00, 0x00, 0x00, 0x00, 0x00
};
// 'pixil-frame-3', 128x64px
const unsigned char ren_logo_pixil_frame_3 [] PROGMEM = {
  0x00, 0x00, 0x00, 0x00, 0x00, 0x00, 0x00, 0x00, 0x00, 0x00, 0x00, 0x00, 0x00, 0x00, 0x00, 0x00,
  0x00, 0x00, 0x00, 0x00, 0x00, 0x00, 0x00, 0x00, 0x00, 0x00, 0x00, 0x00, 0x00, 0x00, 0x00, 0x00,
  0x00, 0x00, 0x00, 0x00, 0x00, 0x00, 0x00, 0x00, 0x00, 0x00, 0x00, 0x00, 0x00, 0x00, 0x00, 0x00,
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  0x00, 0x00, 0x00, 0x00, 0x00, 0x00, 0x00, 0x00, 0x00, 0x00, 0x00, 0x00, 0x00, 0x00, 0x00, 0x00
};
// 'pixil-frame-4', 128x64px
const unsigned char ren_logo_pixil_frame_4 [] PROGMEM = {
  0x00, 0x00, 0x00, 0x00, 0x00, 0x00, 0x00, 0x00, 0x00, 0x00, 0x00, 0x00, 0x00, 0x00, 0x00, 0x00,
  0x00, 0x00, 0x00, 0x00, 0x00, 0x00, 0x00, 0x00, 0x00, 0x00, 0x00, 0x00, 0x00, 0x00, 0x00, 0x00,
  0x00, 0x00, 0x00, 0x00, 0x00, 0x00, 0x00, 0x00, 0x00, 0x00, 0x00, 0x00, 0x00, 0x00, 0x00, 0x00,
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  0x00, 0x00, 0x00, 0x00, 0x00, 0x00, 0x00, 0x00, 0x00, 0x00, 0x00, 0x00, 0x00, 0x00, 0x00, 0x00
};
// 'pixil-frame-5', 128x64px
const unsigned char ren_logo_pixil_frame_5 [] PROGMEM = {
  0x00, 0x00, 0x00, 0x00, 0x00, 0x00, 0x00, 0x00, 0x00, 0x00, 0x00, 0x00, 0x00, 0x00, 0x00, 0x00,
  0x00, 0x00, 0x00, 0x00, 0x00, 0x00, 0x00, 0x00, 0x00, 0x00, 0x00, 0x00, 0x00, 0x00, 0x00, 0x00,
  0x00, 0x00, 0x00, 0x00, 0x00, 0x00, 0x00, 0x00, 0x00, 0x00, 0x00, 0x00, 0x00, 0x00, 0x00, 0x00,
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  0x00, 0x00, 0x00, 0x00, 0x00, 0x00, 0x00, 0x00, 0x00, 0x00, 0x00, 0x00, 0x00, 0x00, 0x00, 0x00
};

// Array of all bitmaps for convenience. (Total bytes used to store images in PROGMEM = 6240)
const int ren_logo_allArray_LEN = 6;
const unsigned char* ren_logo_allArray[6] = {
  ren_logo_pixil_frame_0,
  ren_logo_pixil_frame_1,
  ren_logo_pixil_frame_2,
  ren_logo_pixil_frame_3,
  ren_logo_pixil_frame_4,
  ren_logo_pixil_frame_5
};





U8G2_SSD1306_128X64_NONAME_F_SW_I2C u8g2(U8G2_R0, /* clock=*/ 22, /* data=*/ 21, /* reset=*/ U8X8_PIN_NONE);   // All Boards without Reset of the Display
byte cursorPosition = 0;
const byte relayPin = 4;
String input;
String secretInput;
String finalInput;
String briefcasePassword = "8631";//set default keypad unlock code here
boolean unlocked = false;
boolean forceUnlocked = false;

const byte latchSwitch = 16;  //orange
String IP = WiFi.localIP().toString();


//-----------------------------------------------------------End Header-----------------------------------------------------------
void setup_wifi() {
  delay(10);
  Serial.println("Booting");
  WiFi.mode(WIFI_STA);
  WiFi.begin(ssid, password);
  while (WiFi.waitForConnectResult() != WL_CONNECTED) {
    Serial.println("Connection Failed! Rebooting...");
    delay(5000);
    ESP.restart();
  }
  // Port defaults to 3232
  // ArduinoOTA.setPort(3232);

  // Hostname defaults to esp3232-[MAC]
  ArduinoOTA.setHostname(hostName);

  // No authentication by default
  // ArduinoOTA.setPassword("admin");

  // Password can be set with it's md5 value as well
  // MD5(admin) = 21232f297a57a5a743894a0e4a801fc3
  // ArduinoOTA.setPasswordHash("21232f297a57a5a743894a0e4a801fc3");

  ArduinoOTA
  .onStart([]() {
    String type;
    if (ArduinoOTA.getCommand() == U_FLASH)
      type = "sketch";
    else // U_SPIFFS
      type = "filesystem";

    // NOTE: if updating SPIFFS this would be the place to unmount SPIFFS using SPIFFS.end()
    Serial.println("Start updating " + type);
    u8g2.clearBuffer();
    u8g2.setDrawColor(1);
    u8g2.setFont(u8g2_font_spleen5x8_mf);
    u8g2.drawStr(0, 16, String("Updating " + type).c_str());
    u8g2.sendBuffer();

  })
  .onEnd([]() {
    Serial.println("\nEnd");
    u8g2.setDrawColor(1);
    u8g2.setFont(u8g2_font_spleen5x8_mf);
    u8g2.drawStr(0, 26, "Done");
    u8g2.sendBuffer();
  })
  .onProgress([](unsigned int progress, unsigned int total) {
    Serial.printf("Progress: %u%%\r", (progress / (total / 100)));
    //    u8g2.drawFrame(5, 26, total/100, 12);
    //    u8g2.drawBox(5, 26, (progress / (total / 100)), 12);
    //    u8g2.sendBuffer();
  })
  .onError([](ota_error_t error) {
    Serial.printf("Error[%u]: ", error);
    if (error == OTA_AUTH_ERROR) Serial.println("Auth Failed");
    else if (error == OTA_BEGIN_ERROR) Serial.println("Begin Failed");
    else if (error == OTA_CONNECT_ERROR) Serial.println("Connect Failed");
    else if (error == OTA_RECEIVE_ERROR) Serial.println("Receive Failed");
    else if (error == OTA_END_ERROR) Serial.println("End Failed");
  });

  ArduinoOTA.begin();

  Serial.println("Ready");
  Serial.print("IP address: ");
  Serial.println(WiFi.localIP());
  IP = WiFi.localIP().toString();
}

void reconnect() {
  // Loop until we're reconnected
  while (!client.connected() && (WiFi.status() == WL_CONNECTED)) {
    Serial.print("Attempting MQTT connection...");
    byte mac[5];
    WiFi.macAddress(mac);  // get mac address
    String clientId = String(mac[0]) + String(mac[4]);
    // Attempt to connect
    if (client.connect(clientId.c_str(), MQTT_USER, MQTT_PASSWORD)) {
      Serial.println("connected");
      //Once connected, publish an announcement...
      client.publish(mainPublishChannel, onlineMessage);//change this to required message
      // ... and resubscribe
      for (int i = 0; i < NUM_SUBSCRIPTIONS; i++) {
        client.subscribe(subscribeChannel[i]);
      }
    } else {
      Serial.print("failed, rc=");
      Serial.print(client.state());
      Serial.println(" try again in 5 seconds");
      // Wait 5 seconds before retrying
      wait(5000);
    }
  }

}

void callback(char* topic, byte* payload, unsigned int length) {
  payload[length] = '\0';
  String message = (char*)payload;
  Serial.println("-------new message from broker-----");
  Serial.print("channel:");
  Serial.println(topic);
  Serial.print("data:");
  Serial.write(payload, length);
  Serial.println();
  if (message == "unlock") {
    unlocked = true;
  } else if (message == "lock") {
    unlocked = false;
  } else if (message == "force unlock") {
    digitalWrite(relayPin, HIGH);
    wait(150);
    digitalWrite(relayPin, LOW);
    cursorPosition = 4;
    unlocked = true;
    forceUnlocked = true;
  } else if (message == "ESP RESTART") {
    ESP.restart();
  } else if (!strcmp(topic, subscribeChannel[1])) {
    briefcasePassword = message;
    client.publish(dataChannel, String("Passkey changed to " + String(briefcasePassword)).c_str());
//    Display new passkey    
//    u8g2.clearBuffer();
//    u8g2.setDrawColor(1);
//    u8g2.setFont(u8g2_font_spleen5x8_mf);
//    u8g2.drawStr(0, 16, "Passkey changed to");
//    u8g2.setFont(u8g2_font_spleen6x12_mf);
//    u8g2.drawStr(0, 28, message.c_str());
//    u8g2.sendBuffer();
//    wait(5000);
//    u8g2.clearBuffer();
//    u8g2.drawFrame(0, 0, 128, 63);
//    u8g2.sendBuffer();
  }
}

void checkConnection() {
  unsigned long currentMillis = millis();
  // if WiFi is down, try reconnecting
  if ((WiFi.status() != WL_CONNECTED) && (currentMillis - previousMillis >= interval)) {
    Serial.print(millis());
    Serial.println("Reconnecting to WiFi...");
    WiFi.disconnect();
    delay(100);
    WiFi.begin(ssid, password);
    //WiFi.reconnect();
    previousMillis = currentMillis;
  }
  if ((!client.connected() ) && (WiFi.status() == WL_CONNECTED) ) {
    Serial.println("Lost mqtt connection");
    reconnect();
  }
  if ((currentMillis - previousMillis >= interval)) {
    client.publish(watchdogChannel, watchdogMessage);//Change this to correct watchdog info
    previousMillis = currentMillis;

  }

}

//-----------------------------------------------------------Begin Base Code-----------------------------------------------------------
void setup() {
  
  
  Serial.begin(115200);
  pinMode(relayPin, OUTPUT);
  pinMode(latchSwitch, INPUT_PULLUP);
  Serial.setTimeout(500);  // Set time out for
  setup_wifi();
  client.setServer(mqtt_server, mqtt_port);
  client.setCallback(callback);
  reconnect();
  briefcaseKeypad.begin();


  //  u8g2.setFont(u8g2_font_spleen32x64_mf); // choose a suitable font
  //  u8g2.drawFrame(0, 0, 128, 63);
  //  u8g2.sendBuffer();
  //Display Setup
  u8g2.begin();
  u8g2.clearBuffer();

  u8g2.setDrawColor(1);
  u8g2.setFont(u8g2_font_spleen5x8_mf); // choose a suitable font
  //u8g2.drawXBM(0, 0, 128, 64, ren_logo_pixil_frame_0);
  u8g2.drawStr(16, 16, "C 2099 RennSoft");
  u8g2.drawStr(16, 24, "All Rights Reserved");
  u8g2.sendBuffer();
  //wait(750);
  //boot animation
  bootAnimation();
}



void loop() {
  handleAll();
  byte loopCounter = 0; //increments each loop
  byte slowerLoopCounter = 0; //increments every 10 loops (to adjust blink speed)
  uint32_t longPressTimer = 0;

  //-----------------------------------------------------------Get 4 digit code-----------------------------------------------------------
  while (cursorPosition < 4) {
    briefcaseKeypad.tick();
    handleAll();
    u8g2.setDrawColor(slowerLoopCounter % 2);
    u8g2.drawBox(4 + (cursorPosition * 32), 4, 3, 54);
    u8g2.sendBuffer();
    while (briefcaseKeypad.available()) {
      keypadEvent e = briefcaseKeypad.read();
      //Serial.print((char)e.bit.KEY);
      if (e.bit.EVENT == KEY_JUST_PRESSED) {
        //Serial.println(" pressed");
        input = String((char)e.bit.KEY);
        if (input == "#" || input == "*") {
          longPressTimer = millis();
        } else {
          finalInput = finalInput + input;
          client.publish(dataChannel, input.c_str());
          u8g2.setDrawColor(1);
          u8g2.setFont(u8g2_font_spleen32x64_mf); // choose a suitable font
          u8g2.drawStr(cursorPosition * 32, 51, input.c_str()); // write something to the internal memory
          u8g2.drawFrame(0, 0, 128, 63);
          u8g2.sendBuffer();          // transfer internal memory to the display
          cursorPosition = cursorPosition + 1;
          slowerLoopCounter = 1; //reset the text cursor
        }
      }
      else if (e.bit.EVENT == KEY_JUST_RELEASED && input == "*") {
        //Serial.println(" released");
        longPressTimer = millis() - longPressTimer;
        if (longPressTimer > 3000) {
          cursorPosition = 0;
          input = "";
          finalInput = "";
          drawBorder();
          maintainenceScreen();
        }
        longPressTimer = 0;
      }
    }
    loopCounter++;
    if (loopCounter % 5 == 0) {
      slowerLoopCounter++;
    }
  }

  //Send finalInput
  //Serial.println(finalInput);
  client.publish(dataChannel, finalInput.c_str());

  //Play finishing animation
  u8g2.setDrawColor(0);
  u8g2.drawBox(10, 26, 108, 12);
  u8g2.setDrawColor(1);
  u8g2.drawFrame(10, 26, 108, 12);
  u8g2.sendBuffer();

  for (int i = 1; i < 85; i = i + 6) {
    u8g2.drawBox(10, 26, i, 12);
    u8g2.sendBuffer();
  }

  wait(500);
  u8g2.drawBox(10, 26, 100, 12);
  u8g2.sendBuffer();
  wait(350);
  u8g2.drawBox(10, 26, 109, 12);
  u8g2.sendBuffer();
  wait(1000);


  //-----------------------------------------------------------Evaluate 4 Digit Code-----------------------------------------------------------
  if (finalInput == briefcasePassword) {
    //Serial.println("Authentication Successful");
    //unlocked = true;
    client.publish(dataChannel, "Waiting for unlock signal");
    u8g2.clearBuffer();
    for (int i = 0; i < 13; i++) {
      u8g2.setDrawColor(i % 2 + 1);
      u8g2.drawBox(0, 23, 128, 18);
      u8g2.setDrawColor(i % 2);
      u8g2.setFont(u8g2_font_spleen5x8_mf);
      u8g2.drawStr(3, 32, "Authentication Successful");
      u8g2.sendBuffer();
      wait(100);
    }
    wait(200);
    for (int i = 0; i < 6; i++) {
      u8g2.clearBuffer();
      u8g2.setDrawColor(1);
      u8g2.drawBox(0, 23 - i * 4, 128, 18);
      u8g2.setDrawColor(0);
      u8g2.setFont(u8g2_font_spleen5x8_mf);
      u8g2.drawStr(3, 32 - i * 4, "Authentication Successful");
      u8g2.sendBuffer();
    }
    wait(200);
    u8g2.setDrawColor(1);
    while (unlocked == false) {
      handleAll();
      u8g2.drawStr(40, 32, "Unlocking -");
      u8g2.sendBuffer();
      u8g2.drawStr(40, 32, "Unlocking /");
      u8g2.sendBuffer();
      u8g2.drawStr(40, 32, "Unlocking |");
      u8g2.sendBuffer();
      u8g2.drawStr(40, 32, "Unlocking \\");
      u8g2.sendBuffer();
    }

    //Unlock latch
    client.publish(dataChannel, "Briefcase Unlocked");
    digitalWrite(relayPin, HIGH);
    wait(150);
    digitalWrite(relayPin, LOW);
    u8g2.drawStr(6, 32, "Secure package unlocked.");
    u8g2.sendBuffer();
    wait(2000);

  } else {
    //Serial.println("Authentication Failed");
    u8g2.clearBuffer();
    for (int i = 0; i < 14; i++) {
      u8g2.setDrawColor(i % 2 + 1);
      u8g2.drawBox(0, 23, 128, 18);
      u8g2.setDrawColor(i % 2);
      u8g2.setFont(u8g2_font_spleen5x8_mf);
      if (forceUnlocked) {
        u8g2.drawStr(8, 32, "Authentication Override");
      } else {
        u8g2.drawStr(8, 32, "Authentication Failed");
      }
      u8g2.sendBuffer();
      wait(100);
    }
    wait(1500);
    u8g2.setDrawColor(1);
  }

  //-----------------------------------------------------------Reset for next loop-----------------------------------------------------------
  cursorPosition = 0;
  finalInput = "";
  forceUnlocked = false;

  //  if (unlocked) {
  //    u8g2.clearBuffer();
  //    u8g2.drawXBM(0, 0, 128, 64, ren_logo_pixil_frame_0);
  //    u8g2.sendBuffer();
  //  }

  //Play animation while unlocked
  while (unlocked) {
    handleAll();
    for (int i = 0; i < 7; i++) {
      if (i < 6) {
        u8g2.drawXBM(0, 0, 128, 64, ren_logo_allArray[i]);
        u8g2.sendBuffer();
      } else {
        u8g2.drawXBM(0, 0, 128, 64, ren_logo_allArray[0]);
        u8g2.sendBuffer();
      }
      wait(5);
    }
    wait(10000);
  }
  drawBorder();

}//void loop

void bootAnimation() {

  for (int i = 0; i < 15; i++) { //loading wheel
    u8g2.drawHLine(0, 0, map(i, 0, 10, 0, 128));
    u8g2.drawStr(8, 16, "-");
    u8g2.sendBuffer();
    u8g2.drawStr(8, 16, "/");
    u8g2.sendBuffer();
    u8g2.drawStr(8, 16, "|");
    u8g2.sendBuffer();
    u8g2.drawStr(8, 16, "\\");
    u8g2.sendBuffer();
  }
  wait(100);
  u8g2.drawXBM(0, 0, 128, 64, ren_logo_pixil_frame_0);
  u8g2.sendBuffer();
  wait(500);
  for (int i = 0; i < 7; i++) {
    if (i < 6) {
      u8g2.drawXBM(0, 0, 128, 64, ren_logo_allArray[i]);
      u8g2.sendBuffer();
    } else {
      u8g2.drawXBM(0, 0, 128, 64, ren_logo_allArray[0]);
      u8g2.sendBuffer();
    }
    wait(5);
  }
  wait(1000);
  drawBorder();
}

void handleAll() {
  ArduinoOTA.handle();
  checkConnection();
  client.loop();
}

void wait(uint16_t msWait) {
  uint32_t start = millis();
  while ((millis() - start) < msWait)
  {
    handleAll();
  }
}

void maintainenceScreen() {
  String temporaryInput = "HelloWorld";
  byte page = 0;
  byte counter = 0;
  while (temporaryInput != "*") {
    page = counter % 4;
    switch (page) {
      case 0: //Battery Status
        u8g2.clearBuffer();
        u8g2.setDrawColor(1);
        u8g2.setFont(u8g2_font_spleen5x8_mf);
        u8g2.drawStr(0, 16, "Battery percentage:");
        u8g2.drawStr(0, 26, "No battery connected");
        u8g2.setFont(u8g2_font_spleen5x8_mf);
        u8g2.drawStr(0, 52, "Press * to return");
        u8g2.sendBuffer();
        break;
      case 1: //IP Address
        IP = WiFi.localIP().toString();
        u8g2.clearBuffer();
        u8g2.setDrawColor(1);
        u8g2.setFont(u8g2_font_spleen5x8_mf);
        u8g2.drawStr(0, 16, "IP Address:");
        u8g2.setFont(u8g2_font_spleen8x16_mf);
        u8g2.drawStr(0, 40, IP.c_str());
        u8g2.setFont(u8g2_font_spleen5x8_mf);
        u8g2.drawStr(0, 52, "Press * to return");
        u8g2.sendBuffer();
        break;
      case 2: //Device Name
        u8g2.clearBuffer();
        u8g2.setDrawColor(1);
        u8g2.setFont(u8g2_font_spleen5x8_mf);
        u8g2.drawStr(0, 16, "Device name:");
        u8g2.drawStr(0, 28, hostName);
        u8g2.drawStr(0, 52, "Press * to return");
        u8g2.sendBuffer();
        break;
    }

    briefcaseKeypad.tick();
    handleAll();
    while (briefcaseKeypad.available()) {
      keypadEvent e = briefcaseKeypad.read();
      if (e.bit.EVENT == KEY_JUST_PRESSED) {
        temporaryInput = String((char)e.bit.KEY);
        if (temporaryInput == "#") {
          counter++;
        }
      }
    }
  }
  drawBorder();
}

void drawBorder() {
  u8g2.clearBuffer();
  u8g2.drawFrame(0, 0, 128, 63);
  u8g2.sendBuffer();
}
